## sdkconfig.defaults
```kconfig
# Remote WiFi Configuration for ESP32-P4 + ESP32-C5
# ==================================================

# 核心配置: 启用 ESP-Hosted
CONFIG_ESP_HOSTED_ENABLED=y

# ESP-Hosted 传输层: SDIO
CONFIG_ESP_HOSTED_SDIO_HOST_INTERFACE=y

# 协处理器目标: ESP32-C5
CONFIG_ESP_HOSTED_CP_TARGET_ESP32C5=y

# 开发板: WTDKP4C5 (无预设开发板，手动配置引脚)
# 使用 DEV_BOARD_NONE 以确保所有引脚 range 为 0-100
# P4 默认 SDIO 引脚 (18,19,14,15,16,17) 恰好匹配 WTDKP4C5
CONFIG_ESP_HOSTED_P4_DEV_BOARD_NONE=y
# RESET 引脚需手动覆盖默认值 54 -> 13
CONFIG_ESP_HOSTED_SDIO_GPIO_RESET_SLAVE=13

# SDIO 配置
CONFIG_ESP_HOSTED_SDIO_SLOT_1=y
CONFIG_ESP_HOSTED_SDIO_4_BIT_BUS=y

# eppp_link 传输层: SDIO
CONFIG_EPPP_LINK_DEVICE_SDIO=y

# HTTP 服务器 + WebSocket 支持
CONFIG_HTTPD_WS_SUPPORT=y

# 核心配置: 让 esp_wifi_remote 使用 hosted 库而不是 weak 实现
CONFIG_ESP_WIFI_REMOTE_LIBRARY_HOSTED=y

# 启用 Remote WiFi Support
CONFIG_ESP_WIFI_REMOTE=y

# 从机目标: ESP32-C5
CONFIG_SLAVE_IDF_TARGET_ESP32C5=y

# 启用 WiFi 驱动
CONFIG_ESP_WIFI_ENABLED=y
CONFIG_ESP_WIFI_STA_ENABLED=y

# 网络接口
CONFIG_ESP_NETIF_ENABLED=y
CONFIG_ESP_NETIF_IP_LOOPBACK=y

# NVS 闪存存储 WiFi 凭证
CONFIG_NVS_ENABLED=y
CONFIG_NVS_FLASH_ENABLED=y

# FreeRTOS 设置
CONFIG_FREERTOS_USE_TRACE_FACILITY=y
CONFIG_FREERTOS_VTASKLIST_INCLUDE_COREID=y

# 日志
CONFIG_LOG_DEFAULT_LEVEL_INFO=y
CONFIG_LOG_MAXIMUM_LEVEL_VERBOSE=y

# 禁用未使用的功能
CONFIG_ESP_WIFI_NAN_ENABLED=n
CONFIG_ESP_WIFI_MESH_ENABLED=n
```
